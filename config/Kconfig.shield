## config/Kconfig.shield
```kconfig
# Copyright (c) 2022 The ZMK Contributors
# SPDX-License-Identifier: MIT

config SHIELD_RGBKB_ZEN_REV2_LEFT
	def_bool $(shields_list_contains,rgbkb_zen_rev2_left)

config SHIELD_RGBKB_ZEN_REV2_RIGHT
	def_bool $(shields_list_contains,rgbkb_zen_rev2_right)
```

## config/boards/shields/rgbkb_zen_rev2/Kconfig.defconfig
```kconfig
# Copyright (c) 2022 The ZMK Contributors
# SPDX-License-Identifier: MIT

if SHIELD_RGBKB_ZEN_REV2_LEFT

config ZMK_KEYBOARD_NAME
	default "RGBKB Zen Rev2"

config ZMK_SPLIT_ROLE_CENTRAL
	default y

endif # SHIELD_RGBKB_ZEN_REV2_LEFT

if SHIELD_RGBKB_ZEN_REV2_LEFT || SHIELD_RGBKB_ZEN_REV2_RIGHT

config ZMK_SPLIT
	default y

config ZMK_RGB_UNDERGLOW
	select WS2812_STRIP
	select SPI

# config ZMK_DISPLAY
	
# if ZMK_DISPLAY

config I2C
	default y

config SSD1306
	default y

config SSD1306_REVERSE_MODE
	default y

# endif # ZMK_DISPLAY


endif # SHIELD_RGBKB_ZEN_REV2_LEFT || SHIELD_RGBKB_ZEN_REV2_RIGHT
```
